#include <behaviors.dtsi>
#include <dt-bindings/zmk/keys.h>

t {
    keymap {
        compatible = "zmk,keymap";

        	default_layer {
			bindings = <
				&kp TAB   &kp Q  
			>;

			sensor-bindings = <&inc_dec_kp C_VOL_UP C_VOL_DN>;
		};
    };
};